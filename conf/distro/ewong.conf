## conf/layer.conf
```bitbake
DISTRO = "ewong"

BBPATH .= ":${LAYERDIR}"
BBFILES += "${LAYERDIR}/recipes-*/*/*.bb \
           ${LAYERDIR}/recipes-*/*/*.bbappend"

BBFILE_COLLECTIONS += "ewong"
BBFILE_PATTERN_ewong = "^${LAYERDIR}/"
BBFILE_PRIORITY_ewong = "10"
```

## conf/machine/ewong-wandboard.conf
```bitbake
#@TYPE: Machine
#@NAME: Wandboard i.MX6 Wandboard Duallite
#@SOC: i.MX6DL
#@DESCRIPTION: Machine configuration for i.MX6 Wandboard Duallite
#@MAINTAINER: Alfonso Tames <alfonso@tames.com>

include include/ewong-wandboard.inc

SOC_FAMILY = "mx6:mx6dl:wandboard"

UBOOT_MACHINE = "wandboard_dl_config"

KERNEL_DEVICETREE = "imx6dl-wandboard.dtb"

MACHINE_FEATURES += "bluetooth wifi"
MACHINE_ESSENTIAL_EXTRA_RRECOMMENDS += "kernel-module-remoteproc kernel-module-testremoteproc"

MACHINE_EXTRA_RRECOMMENDS += " \
  bcm4329-nvram-config \
  bcm4330-nvram-config \
"

LICENSE_FLAGS_WHITELIST += "oracle_java"
PACKAGE_CLASSES = "package_ipk"
```
